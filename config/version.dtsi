#define VERSION_MACRO
macro_ver: macro_ver {
compatible = "zmk,behavior-macro";
label = "macro_ver";
#binding-cells = <0>;
bindings = <&kp N2>, <&kp N0>, <&kp N2>, <&kp N4>, <&kp N0>, <&kp N1>, <&kp N1>, <&kp N7>, <&kp MINUS>, <&kp V>, <&kp N3>, <&kp DOT>, <&kp N0>, <&kp MINUS>, <&kp N7>, <&kp N8>, <&kp N5>, <&kp B>, <&kp N2>, <&kp N7>, <&kp N6>, <&kp RET>;
};
